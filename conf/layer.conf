## meta-common/conf/distro/torta.conf
```bitbake
# ================================================================
# Copied from poky@warrior/meta/poky/conf/distro/poky.conf as of 2019-05-07.

DISTRO = "torta"
DISTRO_NAME = "torta (Yocto Project Distro)"
DISTRO_VERSION = "0.1"
DISTRO_CODENAME = "torta-pina"
SDK_VENDOR = "-tortasdk"
SDK_VERSION = "${@d.getVar('DISTRO_VERSION').replace('snapshot-${DATE}', 'snapshot')}"

MAINTAINER = "Byron Johnson <byron@byronjohnson.net>"

TARGET_VENDOR = "-torta"

LOCALCONF_VERSION = "1"

DISTRO_VERSION[vardepsexclude] = "DATE"
SDK_VERSION[vardepsexclude] = "DATE"

# Override these in poky based distros
#TORTA_DEFAULT_DISTRO_FEATURES = "largefile opengl ptest multiarch wayland vulkan"
#TORTA_DEFAULT_EXTRA_RDEPENDS = "packagegroup-core-boot"
#TORTA_DEFAULT_EXTRA_RRECOMMENDS = "kernel-module-af-packet"
TORTA_DEFAULT_DISTRO_FEATURES = "largefile ptest"
TORTA_DEFAULT_EXTRA_RRECOMMENDS = "kernel-module-af-packet"

#TORTA_DEFAULT_EXTRA_RDEPENDS_append = " packagegroup-core-sdk"
#TORTA_DEFAULT_EXTRA_RDEPENDS_append = " packagegroup-core-ssh-openssh"
#TORTA_DEFAULT_EXTRA_RDEPENDS_append = " packagegroup-core-tools-debug"
#TORTA_DEFAULT_EXTRA_RDEPENDS_append = " packagegroup-core-tools-profile"
#TORTA_DEFAULT_EXTRA_RDEPENDS_append = " packagegroup-core-tools-testapps"

#TORTA_DEFAULT_DISTRO_FEATURES_append = " opengl pam"
## FIXME: why does only the previous but not next line work?
#DISTRO_FEATURES_append = " opengl pam"
##TORTA_DEFAULT_DISTRO_FEATURES_append = " x11"

DISTRO_FEATURES ?= "${DISTRO_FEATURES_DEFAULT} ${DISTRO_FEATURES_LIBC} ${TORTA_DEFAULT_DISTRO_FEATURES}"
# Let's disable usrmerge.  Also, when I looked at the implementation in
# bitbake.conf, the implementation looked at first glance broken.
DISTRO_FEATURES_remove = "usrmerge"

PREFERRED_VERSION_linux-yocto ?= "5.0%"

SDK_NAME = "${DISTRO}-${TCLIBC}-${SDKMACHINE}-${IMAGE_BASENAME}-${TUNE_PKGARCH}-${MACHINE}"
SDKPATH = "/opt/${DISTRO}/${SDK_VERSION}"

DISTRO_EXTRA_RDEPENDS += " ${TORTA_DEFAULT_EXTRA_RDEPENDS}"
DISTRO_EXTRA_RRECOMMENDS += " ${TORTA_DEFAULT_EXTRA_RRECOMMENDS}"

TORTAQEMUDEPS = "${@bb.utils.contains("INCOMPATIBLE_LICENSE", "GPL-3.0", "", "packagegroup-core-device-devel",d)}"
DISTRO_EXTRA_RDEPENDS_append_qemuarm = " ${TORTAQEMUDEPS}"
DISTRO_EXTRA_RDEPENDS_append_qemuarm64 = " ${TORTAQEMUDEPS}"
DISTRO_EXTRA_RDEPENDS_append_qemumips = " ${TORTAQEMUDEPS}"
DISTRO_EXTRA_RDEPENDS_append_qemuppc = " ${TORTAQEMUDEPS}"
DISTRO_EXTRA_RDEPENDS_append_qemux86 = " ${TORTAQEMUDEPS}"
DISTRO_EXTRA_RDEPENDS_append_qemux86-64 = " ${TORTAQEMUDEPS}"

TCLIBCAPPEND = ""

PREMIRRORS ??= "\
bzr://.*/.*   http://downloads.yoctoproject.org/mirror/sources/ \n \
cvs://.*/.*   http://downloads.yoctoproject.org/mirror/sources/ \n \
git://.*/.*   http://downloads.yoctoproject.org/mirror/sources/ \n \
gitsm://.*/.* http://downloads.yoctoproject.org/mirror/sources/ \n \
hg://.*/.*    http://downloads.yoctoproject.org/mirror/sources/ \n \
osc://.*/.*   http://downloads.yoctoproject.org/mirror/sources/ \n \
p4://.*/.*    http://downloads.yoctoproject.org/mirror/sources/ \n \
svn://.*/.*   http://downloads.yoctoproject.org/mirror/sources/ \n"

#SANITY_TESTED_DISTROS ?= " \
#            poky-2.6 \n \
#            poky-2.7 \n \
#            ubuntu-16.04 \n \
#            ubuntu-18.04 \n \
#            fedora-28 \n \
#            fedora-29 \n \
#            centos-7 \n \
#            debian-8 \n \
#            debian-9 \n \
#            opensuse-42.3 \n \
#            "

SANITY_TESTED_DISTROS ?= " \
	ubuntu-18.04 \n \
"

# OELAYOUT_ABI allows us to notify users when the format of TMPDIR changes in
# an incompatible way. Such changes should usually be detailed in the commit
# that breaks the format and have been previously discussed on the mailing list
# with general agreement from the core team.
#
OELAYOUT_ABI = "12"

# add poky sanity bbclass
INHERIT += "poky-sanity"

# QA check settings - a little stricter than the OE-Core defaults
WARN_TO_ERROR_QA = "already-stripped compile-host-path install-host-path \
                    installed-vs-shipped ldflags pn-overrides rpaths staticdev \
                    unknown-configure-option useless-rpaths"
WARN_QA_remove = "${WARN_TO_ERROR_QA}"
ERROR_QA_append = " ${WARN_TO_ERROR_QA}"

require conf/distro/include/poky-world-exclude.inc
require conf/distro/include/no-static-libs.inc
require conf/distro/include/yocto-uninative.inc
require conf/distro/include/security_flags.inc
INHERIT += "uninative"

# ================================================================
# # Misc configuration.

# Set the hostname for base-files.
hostname_pn-base-files = "torta"

# Look at PACKAGE_CLASSES (e.g. "package_deb") to install the corresponding
# package manager and preserve the package management files from deletion
# during a build.
EXTRA_IMAGE_FEATURES += "package-management"

# ## Select systemd as the initialization manager, rather than SysVinit (c.f.
# ## 7.24 Select an Initialization Manager from the Yocto Mega Manual).

# Use systemd, and disable sysvinit.
DISTRO_FEATURES += "systemd"
VIRTUAL-RUNTIME_init_manager = "systemd"
DISTRO_FEATURE_remove = "sysvinit"

DISRO_FEATURES_BACKFILL_CONSIDERED = "sysvinit"

# Uncomment to remove initscripts from the image altogether.
# If removed, you'll need to populate volatile somehow.
#VIRTUAL-RUNTIME_initscripts = ""

# Make /var/log/persistent.
# TODO: will "?=" work here?  If so, use "?=".
VOLATILE_LOG_DIR = "no"

# ================================================================
# # Packages to install.

# RDEPENDS vs RRECOMMENDS: RRECOMMENDS doesn't fail if the dependency does.

# Install packages in DISTRO_EXTRA_RDPENDS by installing packagegroup-base.
# packagegroup-base depends on packagegroup-distro-base which depends and recommends DISTRO_EXTRA_RDEPENDS and
# DISTRO_EXTRA_RRECOMMENDS, respectively.  packagegroup-base also depends on
# packagegroup-machine-base which depends and recommends MACHINE_EXTRA_RDEPENDS
# and DISRO_EXTRA_RRECOMMENDS, respectively.
IMAGE_INSTALL_append = " packagegroup-base"
# If there are dependency errors when core-image-full-cmdline attempts to
# perform do_root_fs(), add the packages that are failing here to
# IMAGE_INSTALL to get more information about what's failing, e.g.:
# > ERROR: core-image-full-cmdline-1.0-r0 do_rootfs: Unable to install packages. Command '/home/bairyn/git/yocto-bairyn/build-pi/tmp/work/raspberrypi3_64-bairyn-linux/core-image-full-cmdline/1.0-r0/recipe-sysroot-native/usr/bin/apt-get  install --force-yes --allow-unauthenticated apt dpkg packagegroup-base packagegroup-core-boot packagegroup-core-full-cmdline packagegroup-core-ssh-openssh psplash-raspberrypi run-postinsts' returned 100:
# > Reading package lists...
# > Building dependency tree...
# > Reading state information...
# > Some packages could not be installed. This may mean that you have
# > requested an impossible situation or if you are using the unstable
# > distribution that some required packages have not yet been created
# > or been moved out of Incoming.
# > The following information may help to resolve the situation:
# > 
# > The following packages have unmet dependencies:
# >  packagegroup-base : Depends: packagegroup-distro-base but it is not going to be installed
# >                      Recommends: kernel-module-input but it is not installable
# >                      Recommends: kernel-module-rtc-dev but it is not installable
# >                      Recommends: kernel-module-rtc-proc but it is not installable
# >                      Recommends: kernel-module-rtc-sysfs but it is not installable
# >                      Recommends: kernel-module-unix but it is not installable
# > E: Unable to correct problems, you have held broken packages.
# > 
# > ERROR: core-image-full-cmdline-1.0-r0 do_rootfs: 
# > ERROR: core-image-full-cmdline-1.0-r0 do_rootfs: Function failed: do_rootfs
# > ERROR: Logfile of failure stored in: /home/bairyn/git/yocto-bairyn/build-pi/tmp/work/raspberrypi3_64-bairyn-linux/core-image-full-cmdline/1.0-r0/temp/log.do_rootfs.2581
# > ERROR: Task (/home/bairyn/git/yocto-bairyn/build-pi/../sources/openembedded-core/meta/recipes-extended/images/core-image-full-cmdline.bb:do_rootfs) failed with exit code '1'
#IMAGE_INSTALL_append = " packagegroup-distro-base"

# ================================================================
# # Packages groups to install.

# Note: Some of these package groups are installed by other package groups
#       installed here.

# ## openembedded-core/recipes-core/packagegroups

# ### Install package groups provided by packagegroup-base.bb

# Install packagegroup-base.  (Through packagegroup-base in IMAGE_INSTALL.)
TORTA_DEFAULT_EXTRA_RDEPENDS_append = " packagegroup-base"
# Install packagegroup-base-ext2 with hardware support through packagegroup-base.
# Get hdparm, e2fsprogs, e2fsprogs-e2fsck, and e2fsprogs-mke2fs.
DISTRO_FEATURES_append = " ext2"
# Install packagegroup-base-usbhost with hardware support through packagegroup-base.
# Get usbutils and recommend various kernel-module-* s.
DISTRO_FEATURES_append = " usbhost"
# Install packagegroup-base-bluetooth with hardware support through packagegroup-base.
# Get bluez5 and recommend various kernel-module-* s.
DISTRO_FEATURES_append = " bluetooth bluez5"
# Install packagegroup-base-wifi with hardware support through packagegroup-base.
# Get iw and wpa-supplicant and recommend various kernel-module-* s.
DISTRO_FEATURES_append = " wifi"
# Install packagegroup-base-ipv6 through packagegroup-base.
# Recommend kernel-module-ipv6.
DISTRO_FEATURES_append = " ipv6"
# Install packagegroup-base-zeroconf with hardware support through packagegroup-base.
# Get avahi-daemon.
DISTRO_FEATURES_append = " zeroconf"
# Install packagegroup-base-serial - nevermind, assumes some MACHINE_FEATURES.
# Get setserial and lrzsz.
#TORTA_DEFAULT_EXTRA_RDEPENDS_append = " packagegroup-base-serial"

# ### Install package groups provided by packagegroup-core-boot.bb

# Install packagegroup-core-boot through packagegroup-base.
# Get base-files, base-passwd, busybox, netbase, systemd, udev,
#     and update-alternatives-opkg (and MACHINE_ESSENTIAL_EXTRA_RDEPENDS) and
#     recommend busybox-syslog (and recommend
#     MACHINE_ESSENTIAL_EXTRA_RRECOMMENDS).
# (VIRTUAL-RUNTIME_init-manager is set above, along with further systemd
# configuration.)
#VIRTUAL-RUNTIME_init_manager = "systemd"
TORTA_DEFAULT_EXTRA_RDEPENDS_append = " packagegroup-core-boot"

# ### Install package groups provided by packagegroup-core-buildessential.bb

# Install packagegroup-core-buildessential through packagegroup-base.
# Get autoconf, automake, binutils, binutils-symlinks, cpp, cpp-symlinks, gcc,
#     gcc-symlinks, g++, g++-symlinks, gettext, make, libstdc++, libstdc++-dev,
#     libtool, and pkgconfig.
TORTA_DEFAULT_EXTRA_RDEPENDS_append = " packagegroup-core-buildessential"

# ### Install package groups provided by packagegroup-core-sdk.bb

# Install packagegroup-core-sdk through packagegroup-base.
# Get packagegroup-core-buildessential, coreutils, ccache, diffutils, intltool,
#     perl-module-re, perl-module-text-wrap, findutils, quilt, less, ldd, file,
#     and tcl.
# Note: this installs on the target image.  Comment this out if you want fewer
#       build tools on it.  You can still build software for it with the SDK
#       that's produced.
TORTA_DEFAULT_EXTRA_RDEPENDS_append = " packagegroup-core-sdk"

# ### Install package groups provided by packagegroup-core-ssh-openssh.bb

# Install packagegroup-core-ssh-openssh through packagegroup-base.
# Get openssh.
TORTA_DEFAULT_EXTRA_RDEPENDS_append = " packagegroup-core-ssh-openssh"

# ### Install package groups provided by packagegroup-core-tools-debug.bb

# Install packagegroup-core-tools-debug through packagegroup-base.
# Get gdb, gdbserver, and strace.
TORTA_DEFAULT_EXTRA_RDEPENDS_append = " packagegroup-core-tools-debug"

# ### Install package groups provided by packagegroup-core-tools-profile.bb

# Install packagegroup-core-tools-profile through packagegroup-base.
# Get, if the architecture is supported,
#     powertop, lttng-ust, lttng-tools,
#     lttng-modules, babeltrace, systemtap,
#     and valgrind.
# Recommend perf, blktrace, sysprof, and systemd-analyze.
TORTA_DEFAULT_EXTRA_RDEPENDS_append = " packagegroup-core-tools-profile"

# ### Install package groups provided by packagegroup-core-tools-testapps.bb

# Install packagegroup-core-tools-testapps through packagegroup-base.
# Get blktool, kexec, alsa-utils-amixer, alsa-utils-aplay, ltp, connman-tools,
#     connman-tests, and connman-client.
# packagegroup-core-tools-testapps brings in conmann-tools etc. which bring in
# conmann, which networkmanager conflicts with.  Remove this.
#TORTA_DEFAULT_EXTRA_RDEPENDS_append = " packagegroup-core-tools-testapps"

# ### Install package groups provided by packagegroup-core-go-sdk.bb

# Install packagegroup-core-go-sdk through packagegroup-base.
# Get go-runtime, go-runtime-dev, and go-runtime-staticdev.
# TODO: bitbake thinks this isn't buildable.  (Check HOST_SYS doesn't match negative look-ahead:)
#       > COMPATIBLE_HOST = "^(?!riscv64).*"
#
#TORTA_DEFAULT_EXTRA_RDEPENDS_append = " packagegroup-core-go-sdk"

# ### Install package groups provided by packagegroup-core-tools-self-hosted.bb

# Install packagegroup-self-hosted through packagegroup-base.
# Get packagegroup-self-hosted-debug, packagegroup-self-hosted-sdk,
#     packagegroup-self-hosted-extended, packagegroup-self-hosted-graphics, and
#     packagegroup-self-hosted-host-tools.
# This packagegroup rdepends on libx11-dev.  Get x11 for development in
# DISTRO_FEATURES files.  While we're at it, may as well get wayland.  Wayland
# is cool.
#
# Note: if you don't want or need to be able to build Yocto on the target
#       itself, comment this paragraph out.
DISTRO_FEATURES_append = " x11 opengl wayland"
TORTA_DEFAULT_EXTRA_RDEPENDS_append = " packagegroup-self-hosted"

# Install packagegroup-self-hosted-debug through packagegroup-base.
# Get gdb, gdbserver, rsync, strace, and tcf-agent.
TORTA_DEFAULT_EXTRA_RDEPENDS_append = " packagegroup-self-hosted-debug"

# Install packagegroup-self-hosted-sdk through packagegroup-base.
# Get autoconf, automake, binutils, binutils-symlinks, ccache, coreutils, cpp,
#     cpp-symlinks, distcc, file, findutils, g++, g++-symlinks, gcc,
#     gcc-symlinks, intltool, ldd, less, libstdc++, libstdc++-dev, libtool,
#     make, perl-module-re, perl-module-text-wrap, pkgconfig, quilt, and sed.
# Possibly adds glibc-gconv-ibm850, glibc-utils, and rpcsvc-proto.
TORTA_DEFAULT_EXTRA_RDEPENDS_append = " packagegroup-self-hosted-sdk"

# Install packagegroup-self-hosted-extended through packagegroup-base.
# Get bzip2, chkconfig, chrpath, cpio, curl, diffstat, diffutils, elfutils,
#     expat, gawk, gdbm, gettext, gettext-runtime, git, git-perltools, grep,
#     groff, gzip, settings-daemon, libaio, libusb1, libxml2, lsof, lzo, man,
#     man-pages, mdadm, minicom, mtools, ncurses, ncurses-terminfo-base,
#     nfs-utils, nfs-utils-client, openssl, openssh-scp, openssh-sftp-server,
#     openssh-ssh, opkg, opkg-utils, patch, perl, perl-dev, perl-misc,
#     perl-modules, perl-pod, python, python-modules, python3, python3-modules,
#     python3-git, quota, readline, rpm, setserial, socat, subversion, sudo,
#     sysstat, tar, tcl, texi2html, texinfo, unzip, usbutils, watchdog, wget,
#     which, xinetd, zip, zlib, and xz.
TORTA_DEFAULT_EXTRA_RDEPENDS_append = " packagegroup-self-hosted-extended"

# Install packagegroup-self-hosted-graphics through packagegroup-base.
# Get builder, libgl, libgl-dev, libglu, libglu-dev, libx11-dev,
#     adwaita-icon-theme, xdg-utils, epiphany, l3afpad, pcmanfm, and vte.
TORTA_DEFAULT_EXTRA_RDEPENDS_append = " packagegroup-self-hosted-graphics"

# Install packagegroup-self-hosted-host-tools through packagegroup-base.
# Get e2fsprogs, e2fsprogs-e2fsck, e2fsprogs-mke2fs, e2fsprogs-tune2fs, hdparm,
#     iptables, lsb, mc, mc-fish, mc-helpers, mc-helpers-perl, parted, and
#     screen.
# Recommend various kernel-module-* packages.
TORTA_DEFAULT_EXTRA_RDEPENDS_append = " packagegroup-self-hosted-host-tools"

# ### Add to the SDK package groups provided by nativesdk-packagegroup-sdk-host.bb.
#
# Add to the SDK nativesdk-packagegroup-sdk-host.
# Get (with "nativesdk-" prefix) in the SDK pkgconfig, qemu, qemu-helper, pseudo, unfs3,
#     opkg, libtool, autoconf, automake, shadow, makedevs, cmake, meson,
#     sdk-provides-dummy, bison, and flex.
TOOLCHAIN_HOST_TASK_append = " nativesdk-packagegroup-sdk-host"

# ## openembedded-core/recipes-devtools/packagegroups

# ### Install package groups provided by packagegroup-core-device-devel.bb

# Install packagegroup-core-device-devel through packagegroup-base.
# Get distcc-config, nfs-export-root, bash, and binutils-symlinks.
TORTA_DEFAULT_EXTRA_RDEPENDS_append = " packagegroup-core-device-devel"

# ## openembedded-core/recipes-extended/packagegroups

# ### Install package groups provided by packagegroup-core-base-utils.bb

# Install packagegroup-core-base-utils through packagegroup-base.
# Get base-passwd, bash, bind-utils, bzip2, coreutils, cpio, dhcp-client,
#     diffutils, e2fsprogs, ed, file, findutils, gawk, grep, gzip, inetutils,
#     inetutils-ping, inetutils-telnet, inetutils-tftp, inetutils-traceroute,
#     iproute2, kmod, less, ncurses-tools, net-tools, parted, patch, procps,
#     psmisc, sed, shadow-base, tar, time, unzip, util-linux, vim, wget, which,
#     and xz.
VIRTUAL-RUNTIME_vim = "vim"
TORTA_DEFAULT_EXTRA_RDEPENDS_append = " packagegroup-core-base-utils"


# ### Install package groups provided by packagegroup-core-full-cmdline.bb

# Install packagegroup-core-full-cmdline through packagegroup-base.
# Get packagegroup-core-full-cmdline-libs,
#     packagegroup-core-full-cmdline-utils,
#     packagegroup-core-full-cmdline-extended,
#     packagegroup-core-full-cmdline-dev-utils,
#     packagegroup-core-full-cmdline-multiuser,
#     packagegroup-core-full-cmdline-initscripts, and
#     packagegroup-core-full-cmdline-sys-services.
TORTA_DEFAULT_EXTRA_RDEPENDS_append = " packagegroup-core-full-cmdline"

# Install packagegroup-core-full-cmdline-libs through packagegroup-base.
# Get glib-2.0.
TORTA_DEFAULT_EXTRA_RDEPENDS_append = " packagegroup-core-full-cmdline-libs"

# Install packagegroup-core-full-cmdline-utils through packagegroup-base.
# Get bash, acl, attr, bc, coreutils, cpio, e2fsprogs, ed, file, findutils,
#     gawk, gmp, grep, makedevs, mc, mc-fish, mc-helpers, mc-helpers-perl,
#     ncurses, net-tools, procps, psmisc, sed, tar, time, util-linux, and zlib.
TORTA_DEFAULT_EXTRA_RDEPENDS_append = " packagegroup-core-full-cmdline-utils"

# Install packagegroup-core-full-cmdline-extended through packagegroup-base.
# Get iproute2, iputils, iptables, module-init-tools, and openssl.
TORTA_DEFAULT_EXTRA_RDEPENDS_append = " packagegroup-core-full-cmdline-extended"

# Install packagegroup-core-full-cmdline-dev-utils through packagegroup-base.
# Get diffutils, m4, make, and patch.
TORTA_DEFAULT_EXTRA_RDEPENDS_append = " packagegroup-core-full-cmdline-dev-utils"

# Install packagegroup-core-full-cmdline-initscripts through packagegroup-base.
# Get systemd, ethtool, busybox, and sysklogd.
# (VIRTUAL-RUNTIME_initscripts and _init_manager are set above, along with
# further systemd configuration.)
#VIRTUAL-RUNTIME_initscripts = ""
#VIRTUAL-RUNTIME_init_manager = "systemd"
TORTA_DEFAULT_EXTRA_RDEPENDS_append = " packagegroup-core-full-cmdline-initscripts"

# Install packagegroup-core-full-cmdline-multiuser through packagegroup-base.
# Get bzip2, cracklib, gzip, shadow, and sudo.
TORTA_DEFAULT_EXTRA_RDEPENDS_append = " packagegroup-core-full-cmdline-multiuser"

# Install packagegroup-core-full-cmdline-sys-services through packagegroup-base.
# Get at, cronie, logrotate, nfs-utils, and rpcbind.
TORTA_DEFAULT_EXTRA_RDEPENDS_append = " packagegroup-core-full-cmdline-sys-services"

# ### Install package groups provided by packagegroup-core-lsb.bb

# Install packagegroup-core-lsb through packagegroup-base.
# Get packagegroup-core-sys-extended,
#      packagegroup-core-db, packagegroup-core-perl, packagegroup-core-python,
#      packagegroup-core-tcl, packagegroup-core-lsb-misc,
#      packagegroup-core-lsb-core, packagegroup-core-lsb-perl,
#      packagegroup-core-lsb-python, packagegroup-core-lsb-desktop, and
#      packagegroup-core-lsb-runtime-add.
# This package group requires x11, pam, and opengl.
DISTRO_FEATURES_append = " x11 pam opengl"
TORTA_DEFAULT_EXTRA_RDEPENDS_append = " packagegroup-core-lsb"

# Install packagegroup-core-sys-extended through packagegroup-base.
# Get curl, dhcp-client, hdparm, lighttpd, libaio, lrzsz, lzo, mc, mc-fish,
#     mc-helpers, mc-helpers-perl, mdadm, minicom, parted, quota, screen,
#     setserial, sysstat, unzip, watchdog, wget, which, xinetd, and zip.
TORTA_DEFAULT_EXTRA_RDEPENDS_append = " packagegroup-core-sys-extended"

# Install packagegroup-core-db through packagegroup-base.
# Get db and sqlite3.
TORTA_DEFAULT_EXTRA_RDEPENDS_append = " packagegroup-core-db"

# Install packagegroup-core-perl through packagegroup-base.
# Get qdbm, perl, and zlib.
TORTA_DEFAULT_EXTRA_RDEPENDS_append = " packagegroup-core-perl"

# Install packagegroup-core-python through packagegroup-base.
# Get expat, qdbm, gmp, ncurses, openssl, python, readline, and zip.
TORTA_DEFAULT_EXTRA_RDEPENDS_append = " packagegroup-core-python"

# Install packagegroup-core-tcl through packagegroup-base.
# Get tcl.
#REQUIRE_DISTRO_FEATURES_remove_pn-packagegroup-core-lsb = "x11"
TORTA_DEFAULT_EXTRA_RDEPENDS_append = " packagegroup-core-tcl"

# Install packagegroup-core-lsb-misc through packagegroup-base.
# Get chkconfig, gettext, gettext-runtime, groff, lsbinitscripts, lsbtest,
#     lsof, strace, libusb1, usbutils, rpm.
#TORTA_DEFAULT_EXTRA_RDEPENDS_append = " packagegroup-core-lsb-misc"

# Install packagegroup-core-lsb-core through packagegroup-base.
# Get at, bash, bc, binutils, binutils-symlinks, bzip2, coreutils, cpio,
#     cronie, cups, diffutils, ed, glibc-utils, elfutils, file, findutils,
#     fontconfig-utils, foomatic-filters, gawk, ghostscript, grep, gzip,
#     localedef, lsb, m4, make, man, man-pages, msmtp, patch, procps, psmisc,
#     sed, shadow, tar, time, util-linux, xdg-utils, glibc, libgcc, libpam,
#     libxml2, ncurses, zlib, nspr, and nss.
TORTA_DEFAULT_EXTRA_RDEPENDS_append = " packagegroup-core-lsb-core"

# Install packagegroup-core-lsb-perl through packagegroup-base.
# Get perl, perl-modules, perl-misc, perl-pod, perl-dev, and perl-doc.
#TORTA_DEFAULT_EXTRA_RDEPENDS_append = " packagegroup-core-lsb-perl"

# Install packagegroup-core-lsb-python through packagegroup-base.
# Get python, python-modules, and python-misc.
TORTA_DEFAULT_EXTRA_RDEPENDS_append = " packagegroup-core-lsb-python"

# Install packagegroup-core-lsb-desktop through packagegroup-base.
# Get libxt, libxxf86vm, libdrm, libglu, libxi, libxtst, libx11-locale,
#     xorg-minimal-fonts, gdk-pixbuf-loader-ico, gdk-pixbuf-loader-bmp,
#     gdk-pixbuf-loader-ani, gdk-pixbuf-xlib, liberation-fonts, gtk+, atk, and
#     alsa-lib.
TORTA_DEFAULT_EXTRA_RDEPENDS_append = " packagegroup-core-lsb-desktop"

# Install packagegroup-core-lsb-runtime-add through packagegroup-base.
# Get ldd, pam-plugin-wheel, e2fprogs-mke2fs, mkfontdir, liburi-perl,
#     libxml-parser-perl, libxml-perl, libxml-sax-perl, glibc-localedatas,
#     glibc-gconvs, glibc-charmaps, glibc-binaries, glibc-localedata-posix,
#     glibc-extra-nss, and glibc-pcprofile.
#TORTA_DEFAULT_EXTRA_RDEPENDS_append = " packagegroup-core-lsb-runtime-add"

# ================================================================
# # Individual recipes to install.

# TODO: move the categories into packagegroups in this layer.
# NOTE: adding and removing recipes here seems to invalidate a lot of cache and
#       make builds take much longer, as they seem to require reparsing every
#       recipe.  Consider moving more of this into the layer's configuration.

# ## Standard system configuration packages.
TORTA_DEFAULT_EXTRA_RDEPENDS_append = " os-release"
TORTA_DEFAULT_EXTRA_RDEPENDS_append = " man-db"
#TORTA_DEFAULT_EXTRA_RDEPENDS_append = " psplash"
TORTA_DEFAULT_EXTRA_RDEPENDS_append = " pm-utils"

# ## Distro configuration.
TORTA_DEFAULT_EXTRA_RDEPENDS_append = " network-configuration"
TORTA_DEFAULT_EXTRA_RDEPENDS_append = " openvpn-configuration"
TORTA_DEFAULT_EXTRA_RDEPENDS_append = " one-time-init"
TORTA_DEFAULT_EXTRA_RDEPENDS_append = " init-write-system-info"

# ## Add kernel-devsrc to the SDK.
TOOLCHAIN_TARGET_TASK_append = " kernel-devsrc"

# ## Extra avahi, mdns, and zeroconf packages.
# Install other avahi-* packages that avahi_%.bb provides besides avahi-daemon
# (it is already installed with "zeroconf" in DISTRO_FEATURES).
TORTA_DEFAULT_EXTRA_RDEPENDS_append = " avahi-dnsconfd avahi-autoipd avahi-utils"
# These require X (x11 or wayland).  Disable.
#IMAGE_INSTALL_append = " avahi-ui-utils avahi-discoverer"
# Install zeroconf.
TORTA_DEFAULT_EXTRA_RDEPENDS_append = " zeroconf"

# ## Extra build and development packages (on the target).
TORTA_DEFAULT_EXTRA_RDEPENDS_append = " flex bison"
TORTA_DEFAULT_EXTRA_RDEPENDS_append = " python3 python3-pip ruby"
TORTA_DEFAULT_EXTRA_RDEPENDS_append = " nasm llvm go expect cmake"
TORTA_DEFAULT_EXTRA_RDEPENDS_append = " gperftools"

# Let the target have rust and cargo.
# TODO: figure out why this doesn't build (just line immediately below; the
#       others in this paragraph should remain commented until fixes are made
#       upstream).
#TORTA_DEFAULT_EXTRA_RDEPENDS_append = " rust cargo"
# Sorry, meta-rust doesn't support rust in SDKs yet.  There's a pull request
# that starts work on it upstream.
#TOOLCHAIN_HOST_TASK_append = " nativesdk-rust"
# Let the target have ghc and cabal.
# Sorry, meta-haskell doesn't support ghc and cabal yet.
#TORTA_DEFAULT_EXTRA_RDEPENDS_append = " ghc cabal"
#TOOLCHAIN_HOST_TASK_append = " nativesdk-ghc"

# ## Extra inetutils and network utility packages.
TORTA_DEFAULT_EXTRA_RDEPENDS_append = " inetutils-ping6 inetutils-hostname inetutils-ifconfig"
TORTA_DEFAULT_EXTRA_RDEPENDS_append = " inetutils-tftp inetutils-logger"
TORTA_DEFAULT_EXTRA_RDEPENDS_append = " inetutils-ftp inetutils-ftp inetutils-telnetd"
TORTA_DEFAULT_EXTRA_RDEPENDS_append = " inetutils-inetd"
# - inetutils-rshd: conflicts with xinetd.  Remove.
# - inetutils%.bb also says that rsh, rshd, rcp, rlogin, rlogind, rexec, and
#   rexecd are horribly for security.  Remove them.  They're disabled in
#   EXTRA_OECONF.
# - inetutils-syslogd: conflicts with busybox-syslog.  Remove.
#TORTA_DEFAULT_EXTRA_RDEPENDS_append = " inetutils-rshd inetutils-rsh inetutils-syslogd"

# Install iputils-* (besides iputils, already covered by packagegroup-core-full-cmdline-extended).
TORTA_DEFAULT_EXTRA_RDEPENDS_append = " iputils-ping iputils-arping iputils-tracepath"
TORTA_DEFAULT_EXTRA_RDEPENDS_append = " iputils-traceroute6 iputils-clockdiff iputils-tftpd"
TORTA_DEFAULT_EXTRA_RDEPENDS_append = " iputils-rarpd iputils-rdisc"

# Extra networking packages.
TORTA_DEFAULT_EXTRA_RDEPENDS_append = " nmap"
#TORTA_DEFAULT_EXTRA_RDEPENDS_append = " ifupdown"
TORTA_DEFAULT_EXTRA_RDEPENDS_append = " openvpn"
TORTA_DEFAULT_EXTRA_RDEPENDS_append = " mosh"

# ## Extra video, audio, and multimedia packages.
# (libdrm is already installed by packagegroup-core-lsb-desktop, which I
# wouldn't normally include here, except it is installed by
# packagegroup-core-lsb.  If I really wanted to not include
# packagegroup-core-lsb-desktop, then I could disable the inclusion of
# packagegroup-core-lsb and include all the subcategories except for
# lsb-desktop.)
TORTA_DEFAULT_EXTRA_RDEPENDS_append = " libdrm"

TORTA_DEFAULT_EXTRA_RDEPENDS_append = " ffmpeg"
LICENSE_FLAGS_WHITELIST_append = " commercial_ffmpeg commercial_x264"

TORTA_DEFAULT_EXTRA_RDEPENDS_append = " v4l-utils"
TORTA_DEFAULT_EXTRA_RDEPENDS_append = " flac lame"

# ### GStreamer.

# Fix errors such as the following:
# > ERROR: Nothing RPROVIDES 'gstreamer1.0-omx' (but /home/bairyn/git/yocto-bairyn/build-pi/../sources/openembedded-core/meta/recipes-extended/images/core-image-full-cmdline.bb RDEPENDS on or otherwise requires it)
# > gstreamer1.0-omx was skipped: because it has a restricted license 'commercial'. Which is not whitelisted in LICENSE_FLAGS_WHITELIST
# > NOTE: Runtime target 'gstreamer1.0-omx' is unbuildable, removing...
# > Missing or unbuildable dependency chain was: ['gstreamer1.0-omx']
# > ERROR: Required build target 'core-image-full-cmdline' has no buildable providers.
# > Missing or unbuildable dependency chain was: ['core-image-full-cmdline', 'gstreamer1.0-omx']
LICENSE_FLAGS_WHITELIST_append = " commercial_gstreamer1.0-libav"
LICENSE_FLAGS_WHITELIST_append = " commercial_gstreamer1.0-plugins-ugly"
LICENSE_FLAGS_WHITELIST_append = " commercial_gstreamer1.0-omx commercial_faad2"
LICENSE_FLAGS_WHITELIST_append = " commercial_mpeg2dec commercial_libomxil"
TORTA_DEFAULT_EXTRA_RDEPENDS_append = " gstreamer1.0"
TORTA_DEFAULT_EXTRA_RDEPENDS_append = " gstreamer1.0-plugins-good"
TORTA_DEFAULT_EXTRA_RDEPENDS_append = " gstreamer1.0-plugins-bad gstreamer1.0-plugins-ugly"
TORTA_DEFAULT_EXTRA_RDEPENDS_append = " gstreamer1.0-omx gstreamer1.0-vaapi"
TORTA_DEFAULT_EXTRA_RDEPENDS_append = " gstreamer1.0-rtsp-server"

# Install dev packages, to build gstreamer1.0-rtsp-server examples.
TORTA_DEFAULT_EXTRA_RDEPENDS_append = " gstreamer1.0-dev"
TORTA_DEFAULT_EXTRA_RDEPENDS_append = " gstreamer1.0-plugins-good-dev"
TORTA_DEFAULT_EXTRA_RDEPENDS_append = " gstreamer1.0-plugins-bad-dev gstreamer1.0-plugins-ugly-dev"
TORTA_DEFAULT_EXTRA_RDEPENDS_append = " gstreamer1.0-omx-dev gstreamer1.0-vaapi-dev"
TORTA_DEFAULT_EXTRA_RDEPENDS_append = " gstreamer1.0-rtsp-server-dev"

# Install libav.
TORTA_DEFAULT_EXTRA_RDEPENDS_append = " gstreamer1.0-libav"
#DISTRO_FEATURES_torta_append = " opengl"

# ## Filesystem management packages.
TORTA_DEFAULT_EXTRA_RDEPENDS_append = " gptfdisk"
TORTA_DEFAULT_EXTRA_RDEPENDS_append = " fuse"

# ## Applications and utility packages.
TORTA_DEFAULT_EXTRA_RDEPENDS_append = " tmux zsh htop git tree"
TORTA_DEFAULT_EXTRA_RDEPENDS_append = " lzip"

# ## Network management packages.
TORTA_DEFAULT_EXTRA_RDEPENDS_append = " networkmanager"

# ## Web service packages.
TORTA_DEFAULT_EXTRA_RDEPENDS_append = " nginx"
```
