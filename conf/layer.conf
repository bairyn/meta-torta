## conf/layer.conf
```bitbake
# This file was copied and modified from
# meta-openembedded/meta-oe/con/layer.conf and modified.

# It really depends on order of the layers appearing in BBLAYERS
# variable in toplevel bblayers.conf file, where bitbake will search
# for .inc files and others where bitbake uses BBPATH since it will
# search the directories from first to last as specified in BBPATH
# Therefore if you want a given layer to be considered high priority
# for the .inc and .conf etc. then consider it adding at the beginning
# of BBPATH. For bblayers bitbake will use BBFILES_PRIORITY to resolve
# the recipe contention so the order of directories in BBFILES does
# not matter.

# We have a conf and classes directory, append to BBPATH
BBPATH .= ":${LAYERDIR}"

# We have a recipes directory, add to BBFILES
BBFILES += "${LAYERDIR}/recipes-*/*/*.bb ${LAYERDIR}/recipes-*/*/*.bbappend"

BBFILE_COLLECTIONS += "torta-layer"
BBFILE_PATTERN_torta-layer := "^${LAYERDIR}/"

# Define the priority for recipes (.bb files) from this layer,
# choosing carefully how this layer interacts with all of the
# other layers.

BBFILE_PRIORITY_torta-layer = "6"

# This should only be incremented on significant changes that will
# cause compatibility issues with other layers
LAYERVERSION_torta-layer = "1"

# core: openembedded-core
# openembedded-layer: meta-openembedded/meta-oe
# networking-layer: meta-openembedded/meta-networking
# meta-python: meta-openembedded/meta-python (dependency of networking-layer)
# webserver: meta-openembedded/meta-webserver (for nginx)
# yocto: poky/meta-poky
LAYERDEPENDS_torta-layer = " \
	core \
	openembedded-layer \
	networking-layer \
	webserver \
	yocto \
"

LAYERSERIES_COMPAT_torta-layer = "dunfell"

LICENSE_PATH += "${LAYERDIR}/licenses"

DISTRO_FEATURES += "ld-is-gold"
```

## meta-common/conf/bblayers.conf.sample
```bitbake
LCONF_VERSION = "7"

BBPATH = "${TOPDIR}"
BBFILES ?= ""

BBLAYERS ?= " \
	${TOPDIR}/../sources/openembedded-core/meta \
	${TOPDIR}/../sources/meta-openembedded/meta-oe \
	${TOPDIR}/../sources/meta-openembedded/meta-filesystems \
	${TOPDIR}/../sources/meta-openembedded/meta-networking \
	${TOPDIR}/../sources/meta-openembedded/meta-python \
	${TOPDIR}/../sources/meta-openembedded/meta-webserver \
	${TOPDIR}/../sources/poky/meta-poky \
	${TOPDIR}/../sources/meta-python2 \
	${TOPDIR}/../sources/meta-qt4 \
	${TOPDIR}/../sources/meta-qt5 \
	${TOPDIR}/../sources/meta-uav \
	${TOPDIR}/../sources/meta-tegra \
	${TOPDIR}/../sources/meta-torta \
	${TOPDIR}/../sources/meta-torta/meta-common \
"

LAYERSERIES_COMPAT_qt4-layer_append = " dunfell"
```
